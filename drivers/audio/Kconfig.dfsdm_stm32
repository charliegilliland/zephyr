## drivers/audio/Kconfig.dfsdm_stm32
```kconfig
# STM32 DFSDM driver configuration options

# Copyright (c) 2024 Charlie Gilliland
# SPDX-License-Identifier: Apache-2.0

menuconfig AUDIO_DFSDM_STM32
	bool "STM32 MCU DMIC (DFSDM) controller driver"
	default y
	depends on DT_HAS_ST_STM32_DFSDM_ENABLED
	depends on DT_HAS_ST_STM32_DFSDM_DMIC_ENABLED
#	select CACHE_MANAGEMENT if CPU_HAS_DCACHE
	select DMA
#	select DMA_STM32
	select PINCTRL
	select GPIO
#	select PINCTRL_STM32
	help
	  Enable DMIC support on the STM32 family of processors.

#if AUDIO_DFSDM_STM32
# TODO: some options about DMA buffers - see Kconfig.dmic_mcux
#endif # AUDIO_DFSDM_STM32
```

## dts/bindings/audio/st,stm32-dfsdm-dmic.yaml
```yaml
# Copyright (c) 2024 Charlie Gilliland
# SPDX-License-Identifier: Apache-2.0

description: "STM32 DFSDM DMIC"

compatible: "st,stm32-dfsdm-dmic"

include: [base.yaml, pinctrl-device.yaml]

properties:
  "#address-cells":
    required: true
    const: 1

  "#size-cells":
    required: true
    const: 0

  reg:
    required: true

  clocks:
    required: true

  clock-names:
    required: true

#  resets:
#    required: true

  pinctrl-0:
      required: true

  pinctrl-names:
      required: true

child-binding:
  description: |
    STM32 DFSDM filter configuration.
  
  include: base.yaml

  compatible: "st,dfsdm-filt"

  properties:
    dmas:
      required: true

#    interrupts:
#      required: true

    st,adc-channels:
      type: int
      required: true

    # TODO: st,adc-channel-names

    st,sample-edge:
      type: string
      required: true
      enum:
        - "rising"
        - "falling"

    st,adc-channel-clk-src:
      type: string
      required: true
      # TODO: enum

    st,adc-alt-channel:
      type: int
      default: 0

    st,filter-order:
      type: int
      required: true
      # TODO: enum
  
    # TODO: there are probably more... refer to linux bindings...
    # TODO: right shift...
```

## dts/bindings/misc/st,stm32-dfsdm.yaml
```yaml
# Copyright (c) 2024 Charlie Gilliland
# SPDX-License-Identifier: Apache-2.0

description: "STM32 DFSDM"

compatible: "st,stm32-dfsdm"

include: base.yaml
#include: [base.yaml, reset-device.yaml]

dfsdm-config-cells:
  - chan
  - filt

properties:
  "#address-cells":
    required: true
    const: 1

  "#size-cells":
    required: true
    const: 0

  reg:
    required: true

  clocks:
    required: true

#  "#dfsdm-config-cells":
#    type: int
#    required: true
#    const: 2


#  resets:
#    required: true

#  interrupts:
#    required: true
  
#  interrupt-names:
#    required: true

#  audio-clock:
#    required: true

child-binding:
  description: |
    STM32 DFSDM channel configuration.

  include: [base.yaml]

  compatible: "st,dfsdm-chan"

  properties:
    output-clk-en:
      type: bool

    sample-edge:
      type: string
      default: "rising"
      enum:
        - "rising"
        - "falling"

child-binding:
  description: |
    STM32 DFSDM filter configuration.
  
  include: base.yaml

  compatible: "st,dfsdm-filt"

  properties:
    dmas:
      required: true
    
    # TODO: right shift...
```
